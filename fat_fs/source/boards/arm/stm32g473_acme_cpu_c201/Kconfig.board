## fat_fs/source/boards/arm/stm32g473_acme_cpu_c201/Kconfig.board
```kconfig
# STM32G473 board configuration
# Copyright (c) 2021 Acme CPU
# SPDX-License-Identifier: Apache-2.0

config ACME_CPU_C201
	bool "Acme CPU C201 Board"
	depends on SOC_STM32G474XX
	select BSP_ACME_CPU_C201_DRIVER
```

## input_capture/source/boards/arm/stm32g474re_disco/Kconfig.board
```kconfig
# STM32G473 board configuration
# Copyright (c) 2020 Volodymyr Sirous
# SPDX-License-Identifier: Apache-2.0

config ACME_CPU_C201
	bool "Acme CPU C201 Board"
	depends on SOC_STM32G474XX
	select BSP_ACME_CPU_C201_DRIVER
```

## input_capture/source/boards/arm/stm32g474re_disco/Kconfig.defconfig
```kconfig
# STM32G473 ACME CPU C201 board configuration
# Copyright (c) 2020 Volodymyr Sirous
# SPDX-License-Identifier: Apache-2.0

if BOARD_STM32G473_ACME_CPU_C201

config BOARD
	default "stm32g473_acme_cpu_c201"

endif # BOARD_STM32G473_ACME_CPU
```

## input_capture/source/modules/bsp_fan/Kconfig
```kconfig
# BSP GPIO Driver configuration options
# Copyright (c) 2020 Volodymyr Sirous
# SPDX-License-Identifier: Apache-2.0

config BSP_GPIO_DRIVER
	bool
	bool "Enable Acme CPU BSP Driver"
#	default y
	help
	    Enables Acme CPU C201 Board Support Package Driver

if BSP_GPIO_DRIVER

config BSP_GPIO_DRIVER_INIT_PRIORITY
	int
	default 80
	help
	    Board Support Package GPIO Driver Initialization Priority

endif # BSP_GPIO_DRIVER

module = BSP_GPIO_DRIVER
module-str = bsp_gpio_driver
source "subsys/logging/Kconfig.template.log_config"
```

## input_capture/source/modules/tim_ic/Kconfig
```kconfig
# TIM IC configuration options

# Copyright (c) 2021 Volodymyr Sirous
# SPDX-License-Identifier: Apache-2.0

menuconfig TIM_IC
	bool "Timer Input Capture Drivers"
	help
	  Enable config options for TIM IC drivers.

if TIM_IC

module = TIM_IC
module-str = tim_ic
source "subsys/logging/Kconfig.template.log_config"

rsource "Kconfig.stm32"

endif # TIM_IC
```

## pca9545_test/source/modules/Kconfig
```kconfig
# Copyright (c) 2020 Volodymyr Sirous
# SPDX-License-Identifier: Apache-2.0

rsource "led-pwm/Kconfig"
rsource "pca9545/Kconfig"
```

## pca9545_test/source/modules/led-pwm/Kconfig
```kconfig
# Copyright (c) 2018 Linaro Limited
# SPDX-License-Identifier: Apache-2.0

# Top-level configuration file for LED drivers.

menuconfig ACME_CPU_C201_LED
	bool "LED drivers"
	help
	  Include LED drivers in the system configuration.

if ACME_CPU_C201_LED

#module = ACME_CPU_C201_LED
#module-str = acme_cpu_c201_led
#source "subsys/logging/Kconfig.template.log_config"

config LED_INIT_PRIORITY
	int "LED initialization priority"
	default 90
	help
	  System initialization priority for LED drivers.

config LED_SHELL
	bool "LED shell"
	depends on SHELL
	help
	  Enable LED shell for testing.

rsource "Kconfig.pca9632"

endif # ACME_CPU_C201_LED
```

## pca9545_test/source/modules/led-pwm/Kconfig.pca9632
```kconfig
# Copyright (c) 2018 Savoir-Faire Linux
# SPDX-License-Identifier: Apache-2.0

config PCA9632
	bool "PCA9632 LED driver"
	depends on I2C
	help
	  Enable LED driver for PCA9632.

	  PCA9632 LED driver has 4 channels each with multi-programmable
	  states. Each channel can drive up to 25 mA per LED.
```

## pca9545_test/source/modules/pca9545/Kconfig
```kconfig
# PCA9545 I2C Bus Multiplexer configuration options
# Copyright (c) 2020 Volodymyr Sirous
# SPDX-License-Identifier: Apache-2.0

menuconfig I2C_MGM_PCA95XX
	bool "PCA9545 I2C Bus Multiplexer"
#	depends on I2C_DMA
	depends on I2C
	help
	  Enable driver for PCA9545 I2C Bus Multiplexer.

if I2C_MGM_PCA95XX

module = I2C_MGM
module-str = i2c_mgm
source "subsys/logging/Kconfig.template.log_config"

config I2C_MGM_PCA95XX_INIT_PRIORITY
	int "Set the device driver initialization priority"
	default APPLICATION_INIT_PRIORITY
	help
	    Sets up the device driver initialization priority

endif # PCA9545
```

## spi_flash/source/boards/stm32g473_acme_cpu_c201.conf
```kconfig
CONFIG_FPU=y

#CONFIG_BSP_GPIO_DRIVER=y

#CONFIG_BLOWER_MOTOR_A2=y

# Enable DMA
CONFIG_DMA=y
CONFIG_DMA_STM32=y

#CONFIG_ADC=y

#CONFIG_DAC=y
#CONFIG_DAC_STM32=y

CONFIG_SPI=y
CONFIG_SPI_STM32_INTERRUPT=y
# Enable DMA support for STM32 SPI bus
CONFIG_SPI_STM32_DMA=y

#CONFIG_I2C=y
#CONFIG_I2C_MGM_PCA95XX=y
#CONFIG_I2C_MGM_PCA95XX_INTERRUPT=y
#CONFIG_GPIO_PCA95XX=y
#CONFIG_GPIO_PCA95XX_INT_EXT=y
#CONFIG_GPIO_PCA95XX_INTERRUPT=y

#CONFIG_GPIO_PCAL9539A=y
#CONFIG_GPIO_PCAL9539A_INTERRUPT=y

#CONFIG_PWM=y
#CONFIG_PWM_CAPTURE=y
#CONFIG_TIM_IC=y
#CONFIG_TIM_IC_STM32=y

#CONFIG_SENSOR=y
#CONFIG_BMA280=y
#CONFIG_BME280=y

#CONFIG_ACPU_C201_BSP_DRIVER=y

#CONFIG_DRV10975=y
#CONFIG_STSPIN220=y
#CONFIG_BQ25611D=y
#CONFIG_BQ25611D_INTERRUPT=y

#CONFIG_COUNTER=y
#CONFIG_COUNTER_RTC_STM32_CLOCK_LSE=y
#CONFIG_COUNTER_RTC_STM32_BACKUP_DOMAIN_RESET=n
#CONFIG_COUNTER_RTC_STM32_LSE_DRIVE_MEDIUMHIGH=y

#CONFIG_DISPLAY=y
#CONFIG_ST7789V=y
#CONFIG_CHARACTER_FRAMEBUFFER=y

#CONFIG_ACME_CPU_C201_LED=y
#CONFIG_PCA9632=y

#CONFIG_MODEM=y
#CONFIG_MODEM_GSM_PPP=y

#CONFIG_EEPROM=y
#CONFIG_EEPROM_AT24=y

#CONFIG_DISK_ACCESS=y
#CONFIG_FILE_SYSTEM=y
#CONFIG_FAT_FILESYSTEM_ELM=y
#CONFIG_FS_FATFS_LFN=y
#CONFIG_FS_FATFS_MAX_LFN=64
#CONFIG_DISK_ACCESS_SDHC=y
#CONFIG_DISK_ACCESS_SPI_SDHC=y

CONFIG_FLASH=y
#CONFIG_DISK_ACCESS_FLASH=y
#CONFIG_DISK_FLASH_START=0x10
#CONFIG_DISK_FLASH_MAX_RW_SIZE=100
#CONFIG_DISK_FLASH_ERASE_ALIGNMENT=0x10
#CONFIG_DISK_ERASE_BLOCK_SIZE=0x10
#CONFIG_DISK_VOLUME_SIZE=0x2000
CONFIG_FLASH_STM32_QSPI=y

CONFIG_SHELL=y

CONFIG_CONSOLE=y
CONFIG_SERIAL=y
CONFIG_STDOUT_CONSOLE=y
CONFIG_UART_INTERRUPT_DRIVEN=y
CONFIG_UART_LINE_CTRL=y
CONFIG_UART_CONSOLE=y
CONFIG_UART_CONSOLE_INIT_PRIORITY=60

# Do not disable the CONFIG_APP_LOGGER
#CONFIG_APP_LOGGER=y
#CONFIG_APP_LOGGER_SD_CARD=y
#CONFIG_APP_LOGGER_MAX_CURR_FILESIZE_MB=1
#CONFIG_APP_LOGGER_MAX_FILE_COUNT=3

#CONFIG_LOG_MODE_OVERFLOW=y
#CONFIG_LOG_PROCESS_THREAD=y
#CONFIG_LOG_PROCESS_THREAD_SLEEP_MS=1000
#CONFIG_LOG_PROCESS_THREAD_STACK_SIZE=2048
#CONFIG_LOG_BUFFER_SIZE=2048

#CONFIG_USB=y
#CONFIG_USB_DEVICE_STACK=y
#CONFIG_USB_CDC_ACM=y
#CONFIG_USB_DEVICE_PRODUCT="Zephyr CDC ACM Sample"
#CONFIG_USB_UART_CONSOLE=y
#CONFIG_UART_CONSOLE_ON_DEV_NAME="CDC_ACM_0"
```

## spi_flash/source/dts/bindings/bsp/bsp-fan.yaml
```yaml
# Copyright (c) 2021, Volodymyr Sirous
# SPDX-License-Identifier: Apache-2.0

description: General representation of a three- or four-pin Fan Motor

include: "base.yaml"

compatible: "bsp-fan"

properties:
  label:
    required: true
    type: string
    description: Human readable string describing the device (used as device_get_binding() argument)
  pwms:
    type: phandle-array
    required: false
    description: TIM PWM control and IC speed feedback signals of a fan
  pwm-names:
    type: string-array
    required: false
    description: Names for the PWM and IC signals
```

## spi_flash/source/dts/bindings/gpio/nxp,pcal9539a.yaml
```yaml
# Copyright (c) 2021 Acme CPU

description: PCAL9539A I2C-based GPIO expander

compatible: "nxp,pcal9539a"

include: [gpio-controller.yaml, i2c-device.yaml]

properties:
    label:
      required: true

    has-pud:
      type: boolean
      required: false
      description: Supports pull-up/pull-down

    interrupt-gpios:
      type: phandle-array
      required: false
      description: Interrupt GPIO pin (active-low open-drain)

    "#gpio-cells":
      const: 2

gpio-cells:
  - pin
  - flags
```

## spi_flash/source/dts/bindings/switch/i2c-mgm-switch.yaml
```yaml
# Copyright (c) 2020, Volodymyr Sirous
# SPDX-License-Identifier: Apache-2.0

description: I2C Bus Switch Channel Node

#compatible: "i2c-bus-switch"

#include: [i2c-controller.yaml]

properties:
  reg:
    required: true

  label:
    type: string
    required: true
    description: Human readable string describing the device (used as device_get_binding() argument)

  "#address-cells":
    required: true
    const: 1
  "#size-cells":
    required: true
    const: 0
```

## spi_flash/source/dts/bindings/ui/ui-menu.yaml
```yaml
# Copyright (c) 2020, Volodymyr Sirous
# SPDX-License-Identifier: Apache-2.0

include: "base.yaml"

compatible: "menu-item"

description: Virtual Device for User Interface menu driver

properties:
    label:
        type: string
        required: true
    title:
        type: string
        required: true
        description: Visible title of the menu item
    message:
        type: string
        required: true
        description: A welcome message
    font_idx:
        type: int
        required: false
        description: Optional font selector
    parent_node:
        type: phandle
        required: true
        description: Mount point of the item in the menu tree
    priority:
        type: int
        required: true
        description: Sets the order of items at the same node
```

## ztest_trial/source/modules/myunittest/Kconfig
```kconfig
menuconfig MYUNITTEST
	bool "MYUNITTEST Driver"
	help
	  Enable driver for MYUNITTEST

if MYUNITTEST

module = MYUNITTEST
module-str = myunittest
source "subsys/logging/Kconfig.template.log_config"

config MYUNITTEST_INIT_PRIORITY
	int "Init Priority"
	default APPLICATION_INIT_PRIORITY
	help
	    Device driver initialization priority.

endif # MYUNITTEST
```

## ztest_trial/source/tests/integration/testcase.yaml
```yaml
tests:
  # section.subsection
  testing.ztest:
    build_only: false
    platform_allow: stm32g473_acme_cpu_c201
    tags: testing
```

## ztest_trial/source/tests/stack_random/testcase.yaml
```yaml
tests:
  kernel.memory_protection.stack_random:
    arch_exclude: posix
    build_only: false
    platform_allow: stm32g473_acme_cpu_c201
    tags: memory_protection
```
