/*
 * Copyright (c) 2020 Volodymyr Sirous
 *
 * SPDX-License-Identifier: Apache-2.0
 */

#include <dt-bindings/pinctrl/stm32-pinctrl.h>

&pinctrl {

  tim20_ch1: gpiob_2 {
    /*pinmux = <STM32_PINMUX('B', 2, (STM32_PINMUX_ALT_FUNC_3 | STM32_PUSHPULL_PULLUP | STM32_OSPEEDR_HIGH_SPEED))>;*/
    pinmux = <STM32_PINMUX('B', 2, AF3)>;
  };

};

&timers20 {
  status = "okay";
  pwm20: pwm {
    status = "okay";
    pinctrl-0 = <&tim20_ch1>;
    st,prescaler = <10000>;
    #pwm-cells = <3>;
  };
};