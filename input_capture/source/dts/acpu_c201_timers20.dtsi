/*
 * Copyright (c) 2021 Acme CPU
 *
 * SPDX-License-Identifier: Apache-2.0
 */


&timers20 {
  status = "okay";
  pwm20: pwm {
    status = "okay";
    pinctrl-0 = <&tim20_ch1_pb2>;
    st,prescaler = <50>;
    #pwm-cells = <3>;
  };
};
