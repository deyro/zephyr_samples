/*
 * Copyright (c) 2020 Volodymyr Sirous
 *
 * SPDX-License-Identifier: Apache-2.0
 */


&c201 { 

   sys_fan {
    compatible = "bsp-fan";
    status = "okay";
    pwms =  <&tim_2_pwm 2 65536 PWM_POLARITY_NORMAL>, 	/* period in number of cycles */
            <&tim_2_ic 1 65536 (1 << 3)>;				/* period in number of cycles */
    pwm-names = "speed-ctrl",
                "speed-feedback";
    label = "SYS FAN";
   };
};
