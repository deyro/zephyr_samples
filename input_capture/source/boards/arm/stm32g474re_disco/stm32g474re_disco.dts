/*
 * Copyright (c) 2020 Volodymyr Sirous
 *
 * SPDX-License-Identifier: Apache-2.0
 */

/dts-v1/;

#include <st/g4/stm32g473Xe.dtsi>
#include <../../modules/hal/stm32/dts/st/g4/stm32g473r(b-c-e)tx-pinctrl.dtsi>

/ {
	model = "STMicroelectronics STM32G474RE-DISCOVERY board";
	compatible = "st,stm32g474re-disco";

	chosen {
	    zephyr,console = &usart3;
	    zephyr,shell-uart = &usart3;
	    zephyr,sram = &sram0;
	    zephyr,flash = &flash0;
	};
};

#include <acpu_c201.dtsi>
