## CMakeLists.txt
```
# SPDX-License-Identifier: Apache-2.0
list(APPEND ZEPHYR_EXTRA_MODULES ${CMAKE_CURRENT_SOURCE_DIR}/modules)

cmake_minimum_required(VERSION 3.13.1)

set(PROJ_ROOT ${CMAKE_CURRENT_SOURCE_DIR}/)
set(DTS_ROOT ${CMAKE_CURRENT_SOURCE_DIR}/dts)
#set(DTC_OVERLAY_FILE "boards/stm32g474re_disco.overlay")

set(BOARD_ROOT ${CMAKE_CURRENT_LIST_DIR})
set(BOARD stm32g473_acme_cpu_c201)

find_package(Zephyr REQUIRED HINTS $ENV{ZEPHYR_BASE})
project(ztest_trial)

FILE(GLOB app_sources 
			src/*.c
			)
target_sources(app PRIVATE ${app_sources})
```

## prj.conf
```kconfig
CONFIG_MAIN_STACK_SIZE=2048
CONFIG_HEAP_MEM_POOL_SIZE=4096
CONFIG_IDLE_STACK_SIZE=1024

CONFIG_DEBUG=y
CONFIG_DEBUG_OPTIMIZATIONS=y

CONFIG_OPENOCD_SUPPORT=y

#CONFIG_CODING_GUIDELINE_CHECK=y

CONFIG_LOG=y

CONFIG_PRINTK=y
```

## boards/stm32g473_acme_cpu_c201.conf
```kconfig
CONFIG_MYUNITTEST=y

CONFIG_CONSOLE=y
CONFIG_SERIAL=y
CONFIG_STDOUT_CONSOLE=y
CONFIG_UART_INTERRUPT_DRIVEN=y
CONFIG_UART_LINE_CTRL=y
CONFIG_UART_CONSOLE=y
CONFIG_UART_CONSOLE_INIT_PRIORITY=60
```

## dts/acpu_c201.dtsi
```dts
/{ c201: acpu-c201-board {


   };
 };

#include <gpio_dt_defines.dtsi>

#include <acpu_c201_myunittest.dtsi>
#include <acpu_c201_usart1.dtsi>
```

## dts/acpu_c201_myunittest.dtsi
```dts
&c201 {
  myunittest {
    compatible = "myunittest";
    ut-gpios = <&gpioa 8 (GPIO_OUTPUT_ACTIVE)>;
    label = "MY_UNIT_TEST";
  };
};
```

## dts/stm32g474re_disco/stm32g474re_disco_adc1.dtsi
```dts
/*
 * Copyright (c) 2020 Rohan Dey
 *
 * SPDX-License-Identifier: Apache-2.0
 */

#include <dt-bindings/pinctrl/stm32-pinctrl.h>
#include <st/g4/stm32g473r(b-c-e)tx-pinctrl.dtsi>

&adc1 {
  status = "okay";
};
```

## dts/bindings/myunittest/myunittest.yaml
```yaml
description: General representation

compatible: "myunittest"

properties:
    ut-gpios:
      type: phandle-array
      required: true
    label:
      required: true
      type: string
      description: Human readable string describing the signal (used as device_get_binding() argument)
```

## src/main.c
```c
#include <zephyr.h>
#include <sys/printk.h>
#include <device.h>

#include <stdint.h>
#include <stdio.h>
#include <string.h>

void main(void) {
	printk("Starting app\n");


	while (1) {
		k_sleep(K_MSEC(1500));
	}
}
```
