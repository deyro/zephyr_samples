## CMakeLists.txt
```
# SPDX-License-Identifier: Apache-2.0

list(APPEND ZEPHYR_EXTRA_MODULES ${CMAKE_CURRENT_SOURCE_DIR}/../../modules)

cmake_minimum_required(VERSION 3.13.1)

set(PROJ_ROOT ${CMAKE_CURRENT_SOURCE_DIR}/)
#set(DTS_ROOT ${CMAKE_CURRENT_LIST_DIR}/../../dts)
#set(DTS_ROOT ${CMAKE_CURRENT_SOURCE_DIR}/dts)
#set(DTC_OVERLAY_FILE "boards/stm32g474re_disco.overlay")

#get_filename_component(TEMP_DIR ${CMAKE_CURRENT_SOURCE_DIR} DIRECTORY)
#get_filename_component(TEMP_DIR1 ${TEMP_DIR} DIRECTORY)
#set(DTS_ROOT ${TEMP_DIR1}/dts)
#list(APPEND DTS_ROOT ${TEMP_DIR1}/dts)

set(DTS_ROOT ${CMAKE_CURRENT_LIST_DIR}/../../)
set(BOARD_ROOT ${CMAKE_CURRENT_LIST_DIR}/../../)
set(BOARD stm32g473_acme_cpu_c201)

#message( ${DTS_ROOT} )
#message( ${BOARD_ROOT} )

find_package(Zephyr REQUIRED HINTS $ENV{ZEPHYR_BASE})
project(integration)

FILE(GLOB app_sources src/*.c)
target_sources(app PRIVATE ${app_sources})
```

## prj.conf
```kconfig
CONFIG_ZTEST=y

CONFIG_MAIN_STACK_SIZE=2048
CONFIG_HEAP_MEM_POOL_SIZE=4096
CONFIG_IDLE_STACK_SIZE=1024

CONFIG_DEBUG=y
CONFIG_DEBUG_OPTIMIZATIONS=y

CONFIG_OPENOCD_SUPPORT=y

#CONFIG_CODING_GUIDELINE_CHECK=y

CONFIG_LOG=y
CONFIG_PRINTK=y
```

## src/main.c
```c
/*
 * Copyright (c) 2016 Intel Corporation
 *
 * SPDX-License-Identifier: Apache-2.0
 */

#include <ztest.h>
/**
 * @brief Test Asserts
 *
 * This test verifies various assert macros provided by ztest.
 *
 */
static void test_assert(void)
{
	zassert_true(1, "1 was false");
/*
	zassert_false(0, "0 was true");
	zassert_is_null(NULL, "NULL was not NULL");
	zassert_not_null("foo", "\"foo\" was NULL");
	zassert_equal(1, 1, "1 was not equal to 1");
	zassert_equal_ptr(NULL, NULL, "NULL was not equal to NULL");
*/
}

void test_main(void)
{
	ztest_test_suite(framework_tests,
		ztest_unit_test(test_assert)
	);

	ztest_run_test_suite(framework_tests);
}
```
