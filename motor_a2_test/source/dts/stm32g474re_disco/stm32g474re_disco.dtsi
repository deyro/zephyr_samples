/*
 * Copyright (c) 2020 Rohan Dey
 *
 * SPDX-License-Identifier: Apache-2.0
 */

/*#include "stm32g474re_disco_usart3.dtsi"*/
#include "acme_cpu_c201_usart1.dtsi"
#include "stm32g474re_disco_dac1.dtsi"

