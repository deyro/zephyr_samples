/*
 * Copyright (c) 2020 Rohan Dey
 *
 * SPDX-License-Identifier: Apache-2.0
 */
 
 #include <dt-bindings/pinctrl/stm32-pinctrl.h>

&pinctrl {

  tim17_ch1: gpiob_9 {
    pinmux = <STM32_PINMUX('B', 9, AF1)>;
  };

};

&timers17 {
  status = "okay";
  pwm17: pwm {
    status = "okay";
    pinctrl-0 = <&tim17_ch1>;
    st,prescaler = <1>;
    #pwm-cells = <3>;
  };
};
