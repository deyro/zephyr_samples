/*
 * Copyright (c) 2021 Acme CPU
 *
 * SPDX-License-Identifier: Apache-2.0
 */

&c201 { 
	stspin220 {
		compatible = "st,stspin220";
		label = "STSPIN220";

		pwms = 	<&tim_17_pwm 1 300000000 PWM_POLARITY_NORMAL>,	/* Step Clock PWM period in nanoseconds for 6 Hz */
				<&tim_3_pwm 2 200000 PWM_POLARITY_NORMAL>;	/* Vref PWM period in nanoseconds for 5000 Hz */
		pwm-names = "stepclk", "vref";
	
		step-mode1-gpios = <&io_1 13 (GPIO_OUTPUT_INACTIVE | GPIO_PUSH_PULL)>;
		step-mode2-gpios = <&io_1 12 (GPIO_OUTPUT_INACTIVE | GPIO_PUSH_PULL)>;

		direction-gpios = <&io_1 15 (GPIO_OUTPUT_INACTIVE | GPIO_PUSH_PULL)>;
		
		enable-gpios = <&io_1 11 (GPIO_OUTPUT_INACTIVE | GPIO_PUSH_PULL)>;
		
		standby-gpios = <&io_1 10 (GPIO_OUTPUT_INACTIVE | GPIO_PUSH_PULL)>;
		
		fault-gpios = <&io_1 14 (GPIO_INPUT | GPIO_PULL_UP | GPIO_INT_LEVEL_LOW)>;
	};
};
