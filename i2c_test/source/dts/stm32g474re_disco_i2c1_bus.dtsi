/*
 * Copyright (c) 2020 Rohan Dey
 *
 * SPDX-License-Identifier: Apache-2.0
 */


&pinctrl {
  i2c1_scl: gpiob_8 {
    pinmux = <STM32_PINMUX('B', 8, AF4)>;
  };

  i2c1_sda: gpiob_9 {
    pinmux = <STM32_PINMUX('B', 9, AF4)>;
  };
};

&i2c1 {
  status = "okay";
  clock-frequency = <I2C_BITRATE_FAST>;
  pinctrl-0 = <&i2c1_scl &i2c1_sda>;
};
