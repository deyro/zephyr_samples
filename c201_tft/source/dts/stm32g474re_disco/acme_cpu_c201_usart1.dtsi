/*
 * Copyright (c) 2020 Volodymyr Sirous
 *
 * SPDX-License-Identifier: Apache-2.0
 */

&pinctrl {
  usart1_rx: gpioc_5 {
    pinmux = <STM32_PINMUX('C', 5, AF7)>;
  };
  usart1_tx: gpioc_4 {
    pinmux = <STM32_PINMUX('C', 4, AF7)>;
  };
};

&usart1 {
    status = "okay";
    pinctrl-0 = <&usart1_rx &usart1_tx>;
    current-speed = <115200>;
};
