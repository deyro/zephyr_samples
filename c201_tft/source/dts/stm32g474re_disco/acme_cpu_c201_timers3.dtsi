/*
 * Copyright (c) 2020 Volodymyr Sirous
 *
 * SPDX-License-Identifier: Apache-2.0
 */


&timers3 {
  status = "okay";
  pwm3: pwm {
    status = "okay";
    pinctrl-0 = <&tim3_ch1_pc6 &tim3_ch2_pc7>;
    st,prescaler = <0>;
    #pwm-cells = <3>;
  };
};
