/*
 * Copyright (c) 2021 Acme CPU
 *
 * SPDX-License-Identifier: Apache-2.0
 */


&usart3 {
    status = "okay";
    pinctrl-0 = <&usart3_rx_pb11 &usart3_tx_pc10 &usart3_rts_pb14 &usart3_cts_pb13>;
    current-speed = <115200>;
};
