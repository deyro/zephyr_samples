/*
 * Copyright (c) 2021 Acme CPU
 *
 * SPDX-License-Identifier: Apache-2.0
 */

&i2c3_seg2 {

  ts3usbca4@5d {
    compatible = "ti,ts3usbca4";
    reg = <0x5d>;
    label = "USBC_SBU_MUX";
    oe-gpios = <&io_3 7 GPIO_ACTIVE_LOW>;
  };


};
