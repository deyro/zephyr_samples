/*
 * Copyright (c) 2021 Acme CPU
 *
 * SPDX-License-Identifier: Apache-2.0
 */

/dts-v1/;

#include <st/g4/stm32g473Xe.dtsi>
#include <../../modules/hal/stm32/dts/st/g4/stm32g473r(b-c-e)tx-pinctrl.dtsi>

/ {
	model = "Custom STM32G473 Acme CPU C201 board";
	compatible = "acpu,stm32g473_acme_cpu_c201";

	chosen {
	    zephyr,console = &usart1;
	    zephyr,shell-uart = &usart1;
	    zephyr,sram = &sram0;
	    zephyr,flash = &flash0;
	};
};

#include <acpu_c201.dtsi>
